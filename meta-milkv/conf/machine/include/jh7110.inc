## meta-milkv/conf/machine/include/jh7110.inc
```bitbake
#@TYPE: SOC
#@NAME: StarFive JH7110
#@SOC: StarFive JH7110
#@DESCRIPTION: SOC configuration for the StarFive JH7110

require conf/machine/include/riscv/tune-riscv.inc
require conf/machine/include/soc-family.inc

SOC_FAMILY = "jh7110"

#============================================
# Common Linux Kernel & Uboot Configuration
KERNEL_CLASSES = "kernel-fitimage"
KERNEL_IMAGETYPE = "fitImage"
#============================================

#============================================
# Common Hardware Configuration
SERIAL_CONSOLES = "115200;ttyS0"
MACHINE_FEATURES = "screen keyboard ext2 ext3 serial"
MACHINE_EXTRA_RRECOMMENDS += " kernel-modules"

#============================================

#============================================
# Common Image Configuration
WIC_CREATE_EXTRA_ARGS ?= "--no-fstab-update"
WKS_FILE_DEPENDS:append = " u-boot"
#============================================

#============================================
# Common SBI Configuration
RISCV_SBI_PLAT = "generic"
#============================================
```

## meta-milkv/conf/machine/milkv-mars.conf
```bitbake
#@TYPE: Machine
#@NAME: milkv-mars
#@SOC: Milk-V Mars
#@DESCRIPTION: Machine configuration for the Milk-V Mars board

require include/jh7110.inc

#============================================
# Kernel Configuration
KERNEL_DEVICETREE ?= "starfive/jh7110-starfive-visionfive-2-v1.3b.dtb"
KBUILD_DEFCONFIG ?= "starfive_visionfive2_defconfig"
PREFERRED_PROVIDER_virtual/kernel ?= "linux-starfive"
#============================================

#============================================
# Uboot Configuration
UBOOT_MACHINE = "starfive_visionfive2_defconfig"
UBOOT_DTB_BINARY = "starfive_visionfive2.dtb"
SPL_BINARY = "spl/u-boot-spl.bin.normal.out"
#============================================

#============================================
# Common Image Configuration
IMAGE_FSTYPES:append = " ext4 wic wic.bmap"
IMAGE_BOOT_FILES = " \
	${KERNEL_IMAGETYPE} \
"
WKS_FILE ?= "milkv-mars.wks"
#============================================
```
